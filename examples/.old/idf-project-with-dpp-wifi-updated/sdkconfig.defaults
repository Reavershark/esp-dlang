## examples/.old/idf-project-with-dpp-wifi-updated/sdkconfig.defaults
```kconfig
###########################
# Board-specific settings #
###########################

CONFIG_ESPTOOLPY_FLASHSIZE_4MB=y
CONFIG_PARTITION_TABLE_CUSTOM=y # See partitions.csv
CONFIG_ESP32_REV_MIN_3=y

####################
# General settings #
####################

# Levels: NONE, ERROR, WARN, INFO, DEBUG, VERBOSE
CONFIG_LOG_DEFAULT_LEVEL_INFO=y

#####################################
# Binary size optimization settings #
#####################################

# Optimize for size (-Os)
CONFIG_COMPILER_OPTIMIZATION_SIZE=y
```

## examples/malloc/idf-project/release/sdkconfig.defaults
```kconfig
CONFIG_COMPILER_OPTIMIZATION_PERF=y
CONFIG_COMPILER_OPTIMIZATION_ASSERTIONS_ENABLE=n
```
